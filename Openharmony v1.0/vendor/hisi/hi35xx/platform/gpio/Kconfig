## Openharmony v1.0/vendor/hisi/hi35xx/platform/gpio/Kconfig
```kconfig
config DRIVERS_HDF_PLATFORM_GPIO
    bool "Enable HDF platform gpio driver"
    default n
    depends on DRIVERS_HDF_PLATFORM
    help
      Answer Y to enable HDF platform gpio driver.
```

## Openharmony v1.0/vendor/hisi/hi35xx/platform/hiedmac/Kconfig
```kconfig
config DRIVERS_HIEDMAC
    bool "Enable HIEDMAC"
    default n
    depends on DRIVERS && PLATFORM_HI3559AV100
    help
      Answer Y to enable LiteOS support hiedmac.
```

## Openharmony v1.0/vendor/hisi/hi35xx/platform/hieth-sf/Kconfig
```kconfig
config DRIVERS_HIETH_SF
    bool "Enable hieth-sf"
    depends on DRIVERS_NETDEV && (PLATFORM_HI3518EV200 || PLATFORM_HI3731 || PLATFORM_HI3516CV300 || PLATFORM_HI3516CV500 || PLATFORM_HI3516DV300 || PLATFORM_HI3516EV200 || PLATFORM_HI3516EV300 || PLATFORM_HI3559V200 || PLATFORM_HI3516DV300 || PLATFORM_HI3518EV300)
```

## Openharmony v1.0/vendor/hisi/hi35xx/platform/hisi_sdk/Kconfig
```kconfig
config DRIVERS_HDF_PLATFORM_HISI_SDK
    bool "Enable HDF hisi sdk driver"
    default n
    depends on DRIVERS_HDF_PLATFORM
    help
      Answer Y to enable HDF hisi sdk driver.
```

## Openharmony v1.0/vendor/hisi/hi35xx/platform/i2c/Kconfig
```kconfig
config DRIVERS_HDF_PLATFORM_I2C
    bool "Enable HDF platform i2c driver"
    default n
    depends on DRIVERS_HDF_PLATFORM
    help
      Answer Y to enable HDF platform i2c driver.
```

## Openharmony v1.0/vendor/hisi/hi35xx/platform/mmc/Kconfig
```kconfig
config DRIVERS_MMC
    depends on DRIVERS
    bool "Enable MMC"
    default y
    depends on DRIVERS && FS_VFS
    help
      Answer Y to enable LiteOS support MMC driver.

config DRIVERS_SD_DETECT_BY_SW
    depends on DRIVERS_MMC && (PLATFORM_HI3516EV200 || PLATFORM_HI3518EV300)
    bool "Use software detection instead of hardware interrupt"
    default n
    help
      Answer Y to enable software detection for the MMC/SD card.
      if you choose Y, host driver will disable the insert/remove interrupt and use the sd protocol to detect the card.



config DRIVERS_SD
    depends on DRIVERS_MMC && (PLATFORM_HI3518EV200 || PLATFORM_HI3516EV200 || PLATFORM_HI3516EV300 || PLATFORM_HI3518EV300 || PLATFORM_HI3516DV300)
    bool "Enable MMC0 support SD card type"

config DRIVERS_EMMC
    depends on DRIVERS_MMC && (PLATFORM_HI3518EV200 || PLATFORM_HI3516EV200 || PLATFORM_HI3516EV300 || PLATFORM_HI3518EV300 || PLATFORM_HI3516DV300 || PLATFORM_HI3556V200)
    bool "Enable MMC0 support eMMC type"



choice
    depends on DRIVERS_EMMC && DRIVERS_MMC && FS_VFS
    prompt "EMMC chip mode"
    default DRIVERS_EMMC_HS200
    help
      select EMMC chip mode hs200.
      select EMMC chip mode hs400.

config DRIVERS_EMMC_HS200
    depends on DRIVERS_EMMC
    bool "Enable EMMC HS200 support"
    help
       If you connect the SDIO0 to EMMC chip, figure out which mode of chip and select the mode HS200

config DRIVERS_EMMC_HS400
    depends on DRIVERS_EMMC && (PLATFORM_HI3518EV200 || PLATFORM_HI3516EV300)
    bool "Enable EMMC HS400 support"
    help
       If you connect the SDIO0 to EMMC chip figure out which mode of chip and select the mode HS400

endchoice

config DRIVERS_MMC_SPEEDUP
    depends on DRIVERS_MMC && (PLATFORM_HI3519 || PLATFORM_HI3519V101 || PLATFORM_HI3559)
    bool "Enable MMC support speedup"
    default n
    help
      Answer Y to enable LiteOS support speedup.
```

## Openharmony v1.0/vendor/hisi/hi35xx/platform/mtd/spi_nor/Kconfig
```kconfig
config DRIVERS_MTD_SPI_NOR
    bool "Enable MTD spi_nor flash"
    default y
    depends on DRIVERS_MTD
    help
      Answer Y to support spi_nor flash.
choice
    depends on  DRIVERS_MTD_SPI_NOR
    prompt "SpiNorFlash Chips"
    default DRIVERS_MTD_SPI_NOR_HISFC350

config DRIVERS_MTD_SPI_NOR_HISFC350
    depends on PLATFORM_HI3516A || PLATFORM_HI3731
    bool "Enable hisfc350"
    help
      Answer Y to support hisfc350.

config DRIVERS_MTD_SPI_NOR_HIFMC100
    depends on PLATFORM_HI3518EV200 || PLATFORM_HI3519 || PLATFORM_HI3519V101 || PLATFORM_HI3559  || PLATFORM_HI3516CV300 || PLATFORM_HI3559AV100ES || PLATFORM_HI3559AV100 || PLATFORM_HI3516CV500 || PLATFORM_HI3516DV300 || PLATFORM_HI3516EV200 || PLATFORM_HI3516EV300 || PLATFORM_HI3518EV300 || PLATFORM_HI3556V200 || PLATFORM_HI3559V200
    bool "Enable hifmc100"
    help
      Answer Y to support hifmc100.
endchoice
```

## Openharmony v1.0/vendor/hisi/hi35xx/platform/rtc/Kconfig
```kconfig
config DRIVERS_HDF_PLATFORM_RTC
    bool "Enable HDF platform rtc driver"
    default n
    depends on DRIVERS_HDF_PLATFORM
    help
      Answer Y to enable HDF platform rtc driver.
```

## Openharmony v1.0/vendor/hisi/hi35xx/platform/sdio/Kconfig
```kconfig
config DRIVERS_HDF_PLATFORM_SDIO
    bool "Enable HDF platform sdio driver"
    default n
    depends on DRIVERS_HDF_PLATFORM
    help
      Answer Y to enable HDF platform sdio driver.
```

## Openharmony v1.0/vendor/hisi/hi35xx/platform/spi/Kconfig
```kconfig
config DRIVERS_HDF_PLATFORM_SPI
    bool "Enable HDF platform spi driver"
    default n
    depends on DRIVERS_HDF_PLATFORM
    help
      Answer Y to enable HDF platform spi driver.
```

## Openharmony v1.0/vendor/hisi/hi35xx/platform/uart/Kconfig
```kconfig
config DRIVERS_HDF_PLATFORM_UART
    bool "Enable HDF platform uart driver"
    depends on DRIVERS_HDF_PLATFORM
    help
      Answer Y to enable HDF platform uart driver.
```

## Openharmony v1.0/vendor/hisi/hi35xx/platform/watchdog/Kconfig
```kconfig
config DRIVERS_HDF_PLATFORM_WATCHDOG
    bool "Enable HDF platform watchdog driver"
    default n
    depends on DRIVERS_HDF_PLATFORM
    help
      Answer Y to enable HDF platform watchdog driver.
```

## Openharmony v1.0/vendor/hisi/hi35xx/third_party/uboot/arch/arm/mach-hi35xx/Kconfig
```kconfig
if ARCH_HI35XX

config HI35XX_COMMON
    bool "Hi35xx common options"
    select DM

config SYS_VENDOR
    default "hisilicon"

endif
```

## Openharmony v1.0/vendor/hisi/hi35xx/third_party/uboot/board/hisilicon/hi3516av300/Kconfig
```kconfig
if TARGET_HI3516AV300

config SYS_BOARD
	default "hi3516av300"

config SYS_VENDOR
	default "hisilicon"

config SYS_SOC
	default "hi3516av300"

config SYS_CONFIG_NAME
	default "hi3516av300"

endif
```

## Openharmony v1.0/vendor/hisi/hi35xx/third_party/uboot/board/hisilicon/hi3516cv500/Kconfig
```kconfig
if TARGET_HI3516CV500

config SYS_BOARD
	default "hi3516cv500"

config SYS_VENDOR
	default "hisilicon"

config SYS_SOC
	default "hi3516cv500"

config SYS_CONFIG_NAME
	default "hi3516cv500"

endif
```

## Openharmony v1.0/vendor/hisi/hi35xx/third_party/uboot/board/hisilicon/hi3516dv200/Kconfig
```kconfig
if TARGET_HI3516DV200

config SYS_BOARD
	default "hi3516dv200"

config SYS_VENDOR
	default "hisilicon"

config SYS_SOC
	default "hi3516dv200"

config SYS_CONFIG_NAME
	default "hi3516dv200"

endif
```

## Openharmony v1.0/vendor/hisi/hi35xx/third_party/uboot/board/hisilicon/hi3516ev300/Kconfig
```kconfig
if TARGET_HI3516EV300

config SYS_BOARD
	default "hi3516ev300"

config SYS_VENDOR
	default "hisilicon"

config SYS_SOC
	default "hi3516ev300"

config SYS_CONFIG_NAME
	default "hi3516ev300"

endif
```

## Openharmony v1.0/vendor/hisi/hi35xx/third_party/uboot/board/hisilicon/hi3518ev300/Kconfig
```kconfig
if TARGET_HI3518EV300

config SYS_BOARD
	default "hi3518ev300"

config SYS_VENDOR
	default "hisilicon"

config SYS_SOC
	default "hi3518ev300"

config SYS_CONFIG_NAME
	default "hi3518ev300"

endif
```

## Openharmony v1.0/vendor/hisi/hi35xx/third_party/uboot/board/hisilicon/hi3519av100/Kconfig
```kconfig
if TARGET_HI3519AV100

config SYS_BOARD
	default "hi3519av100"

config SYS_VENDOR
	default "hisilicon"

config SYS_SOC
	default "hi3519av100"

config SYS_CONFIG_NAME
	default "hi3519av100"

endif
```

## Openharmony v1.0/vendor/hisi/hi35xx/third_party/uboot/board/hisilicon/hi3520dv500/Kconfig
```kconfig
if TARGET_HI3520DV500

config SYS_BOARD
	default "hi3520dv500"

config SYS_VENDOR
	default "hisilicon"

config SYS_SOC
	default "hi3520dv500"

config SYS_CONFIG_NAME
	default "hi3520dv500"

endif
```

## Openharmony v1.0/vendor/hisi/hi35xx/third_party/uboot/board/hisilicon/hi3521dv200/Kconfig
```kconfig
if TARGET_HI3521DV200

config SYS_BOARD
	default "hi3521dv200"

config SYS_VENDOR
	default "hisilicon"

config SYS_SOC
	default "hi3521dv200"

config SYS_CONFIG_NAME
	default "hi3521dv200"

endif
```

## Openharmony v1.0/vendor/hisi/hi35xx/third_party/uboot/board/hisilicon/hi3531dv200/Kconfig
```kconfig
if TARGET_HI3531DV200

config SYS_BOARD
	default "hi3531dv200"

config SYS_VENDOR
	default "hisilicon"

config SYS_SOC
	default "hi3531dv200"

config SYS_CONFIG_NAME
	default "hi3531dv200"

endif
```

## Openharmony v1.0/vendor/hisi/hi35xx/third_party/uboot/board/hisilicon/hi3535av100/Kconfig
```kconfig
if TARGET_HI3535AV100

config SYS_BOARD
	default "hi3535av100"

config SYS_VENDOR
	default "hisilicon"

config SYS_SOC
	default "hi3535av100"

config SYS_CONFIG_NAME
	default "hi3535av100"

endif
```

## Openharmony v1.0/vendor/hisi/hi35xx/third_party/uboot/board/hisilicon/hi3556av100/Kconfig
```kconfig
if TARGET_HI3556AV100

config SYS_BOARD
	default "hi3556av100"

config SYS_VENDOR
	default "hisilicon"

config SYS_SOC
	default "hi3556av100"

config SYS_CONFIG_NAME
	default "hi3556av100"

endif
```

## Openharmony v1.0/vendor/hisi/hi35xx/third_party/uboot/board/hisilicon/hi3559av100/Kconfig
```kconfig
if TARGET_HI3559AV100

config SYS_BOARD
	default "hi3559av100"

config SYS_VENDOR
	default "hisilicon"

config SYS_SOC
	default "hi3559av100"

config SYS_CONFIG_NAME
	default "hi3559av100"

endif
```
