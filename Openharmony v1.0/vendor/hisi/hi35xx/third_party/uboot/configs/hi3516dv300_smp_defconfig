## Openharmony v1.0/vendor/hisi/hi35xx/third_party/uboot/drivers/phy/hibvt/Kconfig
```kconfig
config PHY_HISI_USB
	bool "Hisi usb phy driver"
	default y
	---help---
	  support for PHY on Hisilicon Socs. This Phy supports
	  USB 1.5Mb/s, USB 12Mb/s, USB 480Mb/s speeds. It suppots one
	  USB host port to accept one USB device. Support init the phy
	  and adjust phy Eye Diagram.
```

## Openharmony v1.0/vendor/hisi/hi35xx/third_party/uboot/drivers/ufs/Kconfig
```kconfig
menu "UFS Host Controller Support"

config SCSI_UFS
	bool "Support UFS controllers"
	depends on DM_SCSI
	help
	  This selects support for Universal Flash Subsystem (UFS).
	  Say Y here if you want UFS Support.

config CADENCE_UFS
	bool "Cadence platform driver for UFS"
	depends on UFS
        help
	  This selects the platform driver for the Cadence UFS host
	  controller present on present TI's J721e devices.

config TI_J721E_UFS
	bool "Glue Layer driver for UFS on TI J721E devices"
	help
	  This selects the glue layer driver for Cadence controller
	  present on TI's J721E devices.

config UFS
	bool "UFS card support"
	select HAVE_BLOCK_DEVICE
	help
	  This selects Universal Flash Storage support.
	  If you want UFS support, you should say Y here and
	  also to your specific host controller driver.
endmenu
```

## Openharmony v1.0/vendor/hisi/hi3861/hi3861/tools/menuconfig/Kconfig
```kconfig
    menu "Target Chip"
        choice TARGET_CHIP
            prompt "Hi3861"
            default TARGET_CHIP_HI3861
            config TARGET_CHIP_HI3861
                bool "Hi3861"
                help
                    Set Target Chip as Hi3861.
        endchoice
    endmenu

    menu "Security Settings"
        choice TARGET_SIGNATURE_MOD
            prompt "Signature Algorithm for bootloader and upgrade file"
            default TARGET_SIG_SHA256
            config TARGET_SIG_RSA_V15
                bool "RSA_V15"
                help
                    RSA_V15 Signature Algorithm of bootloader and upgrade file.

            config TARGET_SIG_RSA_PSS
                bool "RSA_PSS"
                help
                    RSA_PSS Signature Algorithm of bootloader and upgrade file.

            config TARGET_SIG_ECC
                bool "ECC"
                help
                    ECC Signature Algorithm of bootloader and upgrade file.

            config TARGET_SIG_SHA256
                bool "SHA256"
                help
                    SHA256 Signature Algorithm of bootloader and upgrade file.
        endchoice

        config BOOT_ENCRYPT
            depends on TARGET_SIG_RSA_PSS || TARGET_SIG_ECC || TARGET_SIG_RSA_V15
            bool "Enable bootloader encryption"
            help
                Enable Bootloader encryption.
        config TARGET_BOOT_VER
            int "boot ver(value form 0 to 16)"
            default 0
            help
                Set boot version.
        config TARGET_KERNEL_VER
            int "kernel ver(value form 0 to 48)"
            default 0
            help
                Set kernel version.
        config TEE_HUKS_SUPPORT
            bool "TEE HUKS support"
            default n
            select FILE_SYSTEM_SUPPORT
            help
                Support TEE HUKS interface.
        config TEE_HUKS_DEMO_SUPPORT
            bool "TEE HUKS demo support"
            default n
            select FILE_SYSTEM_SUPPORT
            select TEE_HUKS_SUPPORT
            help
                Support TEE HUKS DEMO interface.
        config FLASH_ENCRYPT_SUPPORT
            bool "FLASH ENCRYPT support(only apply in WIFI CHIP_PKT_32K)"
            default n
            help
                Support encrypt code and data.
    endmenu

    menu "Factory Test Settings"
        config FACTORY_TEST_SUPPORT
            bool "factory test enable"
            default n
            help
                enable factory test in flashboot.
    endmenu

    menu "BSP Settings"
        config I2C_SUPPORT
            bool "i2c driver support"
            default n
            help
                i2c driver support.

        config I2S_SUPPORT
            bool "i2s driver support"
            default n
            help
                i2s driver support.

        config SPI_SUPPORT
            bool "SPI driver support"
            default n
            help
                spi driver support.

        config DMA_SUPPORT
            bool "DMA driver support"
            default n
            help
                dma driver support.

        config SDIO_SUPPORT
            bool "SDIO driver support"
            default n
            help
                sdio driver support.

        config SPI_DMA_SUPPORT
            bool "SPI support DMA"
            default n
            help
                spi driver support DMA transfer.

        config UART_DMA_SUPPORT
            bool "UART support DMA"
            default n
            help
                uart driver support DMA transfer.

        config PWM_SUPPORT
            bool "PWM driver support"
            default n
            help
                pwm driver support.

        config PWM_HOLD_AFTER_REBOOT
            bool "PWM hold after reboot"
            default n
            help
                pwm hold after reboot.

        config AT_SUPPORT
            bool "Enable AT command"
            default y
            help
                enable at command.
        config FILE_SYSTEM_SUPPORT
            bool "Enable file system"
            default n
            help
                enable file system.
        config UART0_SUPPORT
            bool "Enable uart0 IO mux config"
            default y
            help
                Enable uart0 IO mux config.
        config UART1_SUPPORT
            bool "Enable uart1 IO mux config"
            default y
            help
                Enable uart1 IO mux config.
        config UART2_SUPPORT
            bool "Enable uart2 IO mux config"
            default n
            help
                Enable uart2 IO mux config.
    endmenu

    menu "WiFi Settings"
        choice
            prompt "Authentication Option of Radio Parameters"
            default CE_SUPPORT

            config CE_SUPPORT
            bool "CE Authentication"

            config FCC_SUPPORT
            bool "FCC Authentication"

            config MAX_POWER_SUPPORT
            bool "Max Power"
        endchoice
    endmenu

    menu "OTA Settings"
        choice
            prompt "OTA upgrade method"
            default COMPRESSION_OTA_SUPPORT
            config COMPRESSION_OTA_SUPPORT
                bool "compression ota support"
                help
                    compression ota upgrade method.

            config DUAL_PARTITION_OTA_SUPPORT
                bool "dual-partition ota support"
                help
                    dual-patition upgrade method.
        endchoice
    endmenu

    menu "Link Settings"
        config HILINK
            bool "HiLink support"
            default n
            help
                Enable the option to compile hilink module.
    endmenu
```

## Openharmony v1.0/vendor/huawei/hdf/Kconfig
```kconfig
# Copyright (c) Huawei Technologies Co., Ltd. 2020-2020. All rights reserved.

source "../../vendor/hisi/hi35xx/platform/Kconfig"
source "../../vendor/huawei/hdf/wifi/driver/Kconfig"
source "../../vendor/huawei/hdf/input/driver/Kconfig"
source "../../vendor/huawei/hdf/display/driver/Kconfig"
```

## Openharmony v1.0/vendor/huawei/hdf/display/driver/Kconfig
```kconfig
config DRIVERS_HDF_LCD
    bool "Enable HDF Lcd driver"
    default n
    depends on DRIVERS_HDF
    help
      Answer Y to enable HDF Lcd driver.

config DRIVERS_HDF_LCD_ICN9700
    bool "Enable HDF Lcd Icn9700 driver"
    default n
    depends on DRIVERS_HDF_LCD
    help
      Answer Y to enable HDF Lcd Icn9700 driver.
```

## Openharmony v1.0/vendor/huawei/hdf/input/driver/Kconfig
```kconfig
config DRIVERS_HDF_INPUT
    bool "Enable HDF input driver"
    default n
    depends on DRIVERS_HDF
    help
      Answer Y to enable HDF input driver.

config DRIVERS_HDF_TP_5P5_GT911
    bool "Enable HDF tp 5P5 GT911 driver"
    default n
    depends on DRIVERS_HDF_INPUT
    help
      Answer Y to enable HDF TP 5P5 GT911 driver.
```

## Openharmony v1.0/vendor/huawei/hdf/wifi/driver/Kconfig
```kconfig
config DRIVERS_HDF_WIFI
    bool "Enable HDF WiFi Host driver"
    default n
    depends on DRIVERS_HDF
    help
      Answer Y to enable HDF WiFi Host driver.

config DRIVERS_HI3881
    bool "Enable Hi3881 Host driver"
    default n
    depends on DRIVERS_HDF_WIFI
    help
      Answer Y to enable Hi3881 Host driver.
```
