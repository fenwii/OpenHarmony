## Openharmony v1.0/kernel/liteos_a/arch/arm/Kconfig
```kconfig
# ARM Architecture

#
# ARM has 32-bit(Aarch32) and 64-bit(Aarch64) implementations
#
config ARCH_ARM_AARCH32
    bool
    select ARCH_ARM
    help
      32-bit ARM architecture implementations, Except the M-profile.
      It is not limited to ARMv7-A but also ARMv7-R, ARMv8-A 32-bit and etc.

#
# Architecture Versions
#
config ARCH_ARM_V7A
    bool

config ARCH_ARM_VER
    string
    default "armv7-a" if ARCH_ARM_V7A

#
# VFP Hardware
#
config ARCH_FPU_VFP_V3
    bool
    help
      An optional extension to the Arm, Thumb, and ThumbEE instruction sets in the ARMv7-A and ARMv7-R profiles.
      VFPv3U is a variant of VFPv3 that supports the trapping of floating-point exceptions to support code.

config ARCH_FPU_VFP_V4
    bool
    help
      An optional extension to the Arm, Thumb, and ThumbEE instruction sets in the ARMv7-A and ARMv7-R profiles.
      VFPv4U is a variant of VFPv4 that supports the trapping of floating-point exceptions to support code.
      VFPv4 and VFPv4U add both the Half-precision Extension and the fused multiply-add instructions to the features of VFPv3.

config ARCH_FPU_VFP_D16
    bool
    depends on ARCH_ARM_AARCH32
    help
      VPU implemented with 16 doubleword registers (16 x 64-bit).

config ARCH_FPU_VFP_D32
    bool
    depends on ARCH_ARM_AARCH32
    help
      VPU implemented with 32 doubleword registers (32 x 64-bit).

config ARCH_FPU_VFP_NEON
    bool
    help
      Advanced SIMD extension (NEON) support.

config ARCH_FPU
    string
    default "vfpv3"       if ARCH_FPU_VFP_V3 && ARCH_FPU_VFP_D32
    default "vfpv3-d16"   if ARCH_FPU_VFP_V3 && ARCH_FPU_VFP_D16
    default "neon-vfpv4"  if ARCH_FPU_VFP_V4 && ARCH_FPU_VFP_D32 && ARCH_FPU_VFP_NEON
    default "vfpv4"       if ARCH_FPU_VFP_V4 && ARCH_FPU_VFP_D32
    default "vfpv4-d16"   if ARCH_FPU_VFP_V4 && ARCH_FPU_VFP_D16

#
# Supported Processor Cores
#
config ARCH_CORTEX_A7
    bool
    select ARCH_ARM_V7A
    select ARCH_ARM_AARCH32
    select ARCH_FPU_VFP_V4
    select ARCH_FPU_VFP_D32
    select ARCH_FPU_VFP_NEON

config ARCH_CPU
    string
    default "cortex-a7" if ARCH_CORTEX_A7
```

## Openharmony v1.0/kernel/liteos_a/bsd/Kconfig
```kconfig
config  COMPAT_BSD
    bool "Enable FreeBSD"
    default y

    help
      Answer Y to enable LiteOS support FreeBSD.
```

## Openharmony v1.0/kernel/liteos_a/bsd/dev/usb/Kconfig
```kconfig
config DRIVERS_USB
    bool "Enable USB"
    default y
    depends on DRIVERS && COMPAT_BSD
    help
      Answer Y to enable LiteOS support usb.

config DRIVERS_USB_HOST_DRIVER
    bool "Enable USB HCD"
    default y
    depends on DRIVERS_USB && DRIVERS
    help
      Answer Y to enable LiteOS to support usb host controller driver.

choice
    depends on DRIVERS_USB_HOST_DRIVER
    prompt "USB HCD"
    default y
    help
      Enable EHCI for USB 2.0.
      Enable XHCI for USB 3.0

config DRIVERS_USB_HOST_EHCI
    bool "Enable EHCI HCD (USB 2.0)"
    depends on DRIVERS_USB

config DRIVERS_USB_HOST_XHCI
    bool "Enable XHCI HCD (USB 3.0)"
    depends on DRIVERS_USB

endchoice

choice
    depends on PLATFORM_HI3556AV100 && DRIVERS_USB_HOST_XHCI
    prompt ""
    default DRIVERS_USB3_HOST_FOR_PORT1
    help
      This selects the usb3.0 port or usb2.0 port.

config DRIVERS_USB3_HOST_FOR_PORT1
    bool "Enable USB3.0 Host Controller For USB3.0 Port1"

config DRIVERS_USB3_HOST_FOR_PORT2
    bool "Enable USB3.0 Host Controller For USB2.0 Port2"

endchoice

config DRIVERS_USB_DEVICE_CLASS_DRIVERS
    bool "Enable USB Device Class Drivers"
    default y
    depends on DRIVERS_USB && DRIVERS && DRIVERS_USB_HOST_DRIVER
    help
      Answer Y to enable LiteOS to support usb device class drivers.

menu "USB Device Class Drivers"
    depends on DRIVERS_USB_DEVICE_CLASS_DRIVERS
config DRIVERS_USB_MASS_STORAGE
    bool "Enable USB Mass Storage Support"
    default y
    depends on DRIVERS_USB_DEVICE_CLASS_DRIVERS && FS_VFS
    help
      Say Y here if you want to connect USB mass storage devices to your system's USB port.

config DRIVERS_USB_RNDIS_HOST
    bool "Enable USB Rndis Host Support"
    default y
    depends on DRIVERS_USB_DEVICE_CLASS_DRIVERS && NET_LWIP_SACK
    help
      Say Y here if you want to connect USB Rndis Host devices to your system's USB port.

config DRIVERS_USB_4G_MODEM
    bool "Enable USB 4G Modem Support"
    default y
    depends on DRIVERS_USB_DEVICE_CLASS_DRIVERS && NET_LWIP_SACK
    help
      Say Y here if you want to connect USB 4G devices to your system's USB port.

config DRIVERS_USB_SERIAL
    bool "Enable USB Serial Converter Support"
    default y
    depends on DRIVERS_USB_DEVICE_CLASS_DRIVERS
    help
      Say Y here if you want to connect USB serial devices to your system's USB port.

config DRIVERS_USB_ETHERNET
    bool "Enable USB Ethernet Support"
    depends on NET_LWIP_SACK && DRIVERS_USB_DEVICE_CLASS_DRIVERS
    help
      Say Y here if you want to connect USB ethernet devices to your system's USB port.

config DRIVERS_USB_WIRELESS
    bool "Enable USB Wireless Device Support"
    depends on NET_LWIP_SACK && DRIVERS_USB_DEVICE_CLASS_DRIVERS
    help
      Say Y here if you want to connect usb-wifi devices to your system's USB port.
config DRIVERS_USB_HID_CLASS
    bool "Enable USB HID Device Support"
    depends on DRIVERS_USB_DEVICE_CLASS_DRIVERS && FS_VFS
    help
      Say Y here if you want to connect hid devices to your system's USB port.

endmenu
```

## Openharmony v1.0/kernel/liteos_a/compat/posix/Kconfig
```kconfig
config  COMPAT_POSIX
    bool "Enable Posix"
    default y

    help
      Answer Y to enable LiteOS support posix interface.
```

## Openharmony v1.0/kernel/liteos_a/fs/fat/Kconfig
```kconfig
config FS_FAT
    bool "Enable FAT"
    default y
    depends on FS_VFS
    help
      Answer Y to enable LiteOS support fat filesystem.

config FS_FAT_CACHE
    bool "Enable FAT Cache"
    default y
    depends on FS_FAT
    help
      Answer Y to enable LiteOS fat filesystem support cache.

config FS_FAT_CACHE_SYNC_THREAD
    bool "Enable FAT Cache Sync Thread"
    default n
    depends on FS_FAT_CACHE
    help
      Answer Y to enable LiteOS fat filesystem support cache sync thread.

config FS_FAT_CHINESE
    bool "Enable Chinese"
    default y
    depends on FS_FAT
    help
      Answer Y to enable LiteOS fat filesystem support Chinese.

config FS_FAT_VIRTUAL_PARTITION
    bool "Enabel Virtual Partition"
    default n
    depends on FS_FAT

config FS_FAT_VOLUMES
    int
    depends on FS_FAT
    default 32 if PLATFORM_HI3731
    default 16

config FS_FAT_DISK
    bool "Enable partinfo for storage device"
    depends on FS_FAT || DRIVERS_MMC || DRIVERS_USB
    default y
```

## Openharmony v1.0/kernel/liteos_a/fs/jffs2/Kconfig
```kconfig
config FS_JFFS
    bool "Enable JFFS2"
    default y
    depends on FS_VFS
    help
      Answer Y to enable LiteOS support jffs2 filesystem.
```

## Openharmony v1.0/kernel/liteos_a/fs/nfs/Kconfig
```kconfig
config FS_NFS
    bool "Enable NFS"
    default y
    depends on FS_VFS
    depends on NET_LWIP_SACK
    help
      Answer Y to enable LiteOS support nfs filesystem.
```

## Openharmony v1.0/kernel/liteos_a/fs/ramfs/Kconfig
```kconfig
config FS_RAMFS
    bool "Enable RAMFS"
    default y
    depends on FS_VFS
    help
      Answer Y to enable LiteOS support ramfs filesystem.
```

## Openharmony v1.0/kernel/liteos_a/fs/vfs/Kconfig
```kconfig
config FS_VFS
    bool "Enable VFS"
    default y

    help
      Answer Y to enable LiteOS support virtual filesystem.

config FS_VFS_BLOCK_DEVICE
    bool "Enable Block DEVICE"
    default n
    depends on FS_VFS
    help
      Answer Y to enable LiteOS support read/open/seek/write block device.

config FILE_MODE
    bool "Enable FILE MODE"
    default y
    depends on FS_VFS
    help
      Answer Y to enable LiteOS support file mode.
```

## Openharmony v1.0/kernel/liteos_a/kernel/Kconfig
```kconfig
menu "Kernel"
config KERNEL_SMP
    bool "Enable Kernel SMP"
    default n
    help
      This option will enable smp support of LiteOS.

config KERNEL_SMP_CORE_NUM
    int "Muti-processing Core Numbers"
    default 2
    depends on KERNEL_SMP
    help
      This represents the number of muti-processing cores.

config KERNEL_SMP_LOCKDEP
    bool "Enable Spinlock Lockdep Check"
    default n
    depends on KERNEL_SMP
    help
      This option will enable spinlock lockdep check.

config KERNEL_SMP_TASK_SYNC
    bool "Enable Synchronized Task Operations"
    default n
    depends on KERNEL_SMP
    help
      This option will enable task synchronized operate task across cores.

config KERNEL_SCHED_STATISTICS
    bool "Enable Scheduler statistics"
    default n
    depends on KERNEL_SMP
    help
      This option will enable schedulder statistics.

config KERNEL_EXTKERNEL
    bool "Enable Extend Kernel"
    default y
    help
      This option will enable extend Kernel of LiteOS.  Extend kernel include
      cppsupport, cpup, and dynload. You can select one or some
      of them.

config KERNEL_CPPSUPPORT
    bool "C++ Support"
    default y
    depends on KERNEL_EXTKERNEL
    help
      If you wish to build LiteOS with support for C++.

config KERNEL_CPUP
    bool "Enable Cpup"
    default y
    depends on KERNEL_EXTKERNEL
    help
      If you wish to build LiteOS with support for cpup.

config CPUP_INCLUDE_IRQ
    bool "Enable Cpup include irq"
    default y
    depends on KERNEL_CPUP
    help
      If you wish to include irq usage for cpup.

config KERNEL_DYNLOAD
    bool "Enable Dynamic Load Feature"
    default y
    depends on KERNEL_EXTKERNEL
    help
      If you wish to build LiteOS with support for dynamic load.

config ASLR
    bool "Enable Address Space Layout Randomization"
    default n
    depends on KERNEL_DYNLOAD && HW_RANDOM_ENABLE
    help
      If you wish to enable ASLR for user aspace.

config KERNEL_VDSO
    bool "Enable VDSO Feature"
    default n
    depends on KERNEL_EXTKERNEL
    help
      If you wish to speed up some system calls.

config KERNEL_TICKLESS
    bool "Enable Tickless Feature"
    default y
    depends on KERNEL_EXTKERNEL
    help
      If you wish to build LiteOS with support for tickless.

config KERNEL_TRACE
    bool "Enable Trace Feature"
    default n
    depends on KERNEL_EXTKERNEL
    help
      If you wish to record LiteOS's task and interrupt switch trace.

config KERNEL_LITEIPC
    bool "Enable liteipc"
    default y
    depends on KERNEL_EXTKERNEL
    help
      Answer Y to enable LiteOS support liteipc.

config KERNEL_PIPE
    bool "Enable pipes"
    default y
    depends on KERNEL_EXTKERNEL
    help
      Answer Y to enable LiteOS support pipes.

config BASE_CORE_HILOG
    bool "Enable Hilog"
    default y
    help
      If you wish to include hilog.

endmenu
```

## Openharmony v1.0/kernel/liteos_a/kernel/common/Kconfig
```kconfig
config PLATFORM_ROOTFS
    bool "Enable ROOTFS"
    default y
    depends on FS_JFFS || FS_FAT
    help
      Answer Y to enable LiteOS support rootfs.
```

## Openharmony v1.0/kernel/liteos_a/lib/Kconfig
```kconfig
menu "Lib"
config LIB_LIBC
    bool "Enable Libc"
    default y
    help
      Answer Y to enable libc for full code.

config LIB_ZLIB
    bool "Enable Zlib"
    default y
    depends on LIB_LIBC
    help
      Answer Y to enable LiteOS support compress file library.
endmenu
```

## Openharmony v1.0/kernel/liteos_a/net/Kconfig
```kconfig
menu "Net"
#config NET_LWIP
#   bool "Enable Lwip"
#   default y

#   help
#     extend kernel include runstop, dynload, scatter and cppsupport.
#     It can support all or some.

config NET_LWIP_SACK
    bool "Enable Lwipsack"
    default y

    help
      Answer Y to enable LiteOS support lwip.

choice
    depends on NET_LWIP_SACK
    prompt "Lwipsack"
    default y
    help
      Enable Lwipsack for 2.x

config NET_LWIP_SACK_2_1
    bool "Enable Lwipsack (2.1)"
    depends on NET_LWIP_SACK

endchoice
endmenu
```

## Openharmony v1.0/kernel/liteos_a/net/telnet/Kconfig
```kconfig
config NET_TELNET
    bool "Enable Telnet"
    default y
    depends on NET_LWIP_SACK && SHELL && DEBUG_VERSION
    help
      Answer Y to enable LiteOS support telnet tool.
```

## Openharmony v1.0/kernel/liteos_a/platform/Kconfig
```kconfig
config PLATFORM
    string
    default "hi3516dv300"     if PLATFORM_HI3516DV300
    default "hi3518ev300"     if PLATFORM_HI3518EV300

choice
    prompt "Board"
    default PLATFORM_HI3516DV300
    help
      IPC has several chips:
      hi3516dv300
      hi3518ev300

config PLATFORM_HI3516DV300
    bool "hi3516dv300"
    select ARCH_CORTEX_A7

config PLATFORM_HI3518EV300
    bool "hi3518ev300"
    select ARCH_CORTEX_A7

endchoice

config TEE_ENABLE
    bool "ENABLE TEE"
    default n
    depends on PLATFORM_HI3516DV300
    help
        ENABLE teeos in platform

choice
    prompt "IRQCHIP"
    default PLATFORM_BSP_GIC_V2
    help
      Interrupt Controller.

config PLATFORM_BSP_GIC_V2
    bool "GIC Version 2"
    help
      This GIC(General Interrupt Controller) version 2 driver is compatatble with
      GIC version 1 and version 2.

config PLATFORM_BSP_GIC_V3
    bool "GIC Version 3"
    depends on ARCH_ARM_V8A || ARCH_ARM_V8R
    help
      General Interrupt Controller version 3.

endchoice
```

## Openharmony v1.0/kernel/liteos_a/security/Kconfig
```kconfig
config SECURITY
    bool "Enable Security Module"
    default y
    help
      This option will enable security module. This is a basic feature,
      so you should say Y here.

config SECURITY_CAPABILITY
    bool "Enable Syscall Capability"
    default y
	depends on SECURITY
    help
      This option will enable capability control for syscalls. This is a basic feature,
      so you should say Y here.

config SECURITY_VID
    bool "Enable visual ID"
    default y
	depends on SECURITY
    help
      This option will enable visual ID for timer. This is a basic feature,
      so you should say Y here.

config SECURITY_BOOT
    bool "Enable security boot"
    default n
    depends on SECURITY
    help
      This option will enable security boot.
```

## Openharmony v1.0/kernel/liteos_a/shell/Kconfig
```kconfig
config SHELL
    bool "Enable Shell"
    default y
    depends on DEBUG_VERSION
    help
      Answer Y to enable LiteOS support shell cmd.

menu "Functionality of Shell"
    depends on SHELL

config SHELL_LK
    bool "Enable Shell lk"
    default y
    depends on DEBUG_VERSION && SHELL
    help
      Answer Y to enable LiteOS support shell lk.

config SHELL_DMESG
    bool "Enable Shell dmesg"
    default n
    depends on DEBUG_VERSION && SHELL && SHELL_CMD_DEBUG
    help
      Answer Y to enable LiteOS support shell dmesg.

config SHELL_EXCINFO
    bool "Enable Shell excInfo"
    default n
    depends on DEBUG_VERSION && SHELL
    help
      Answer Y to enable LiteOS support shell excInfo.

endmenu
```

## Openharmony v1.0/vendor/hisi/hi35xx/platform/Kconfig
```kconfig
config DRIVERS_HDF_PLATFORM
    bool "Enable HDF platform driver"
    default n
    depends on DRIVERS_HDF
    help
      Answer Y to enable HDF platform driver.

source "../../vendor/hisi/hi35xx/platform/i2c/Kconfig"
source "../../vendor/hisi/hi35xx/platform/spi/Kconfig"
source "../../vendor/hisi/hi35xx/platform/gpio/Kconfig"
source "../../vendor/hisi/hi35xx/platform/watchdog/Kconfig"
source "../../vendor/hisi/hi35xx/platform/sdio/Kconfig"
source "../../vendor/hisi/hi35xx/platform/rtc/Kconfig"
source "../../vendor/hisi/hi35xx/platform/hisi_sdk/Kconfig"
```
